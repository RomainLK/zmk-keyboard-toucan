// Copyright 2022 Manna Harbour
// https://github.com/manna-harbour/miryoku

// Include config files early for conditional defines
#include "mapping/42/corne.h"
#include "custom_config.h"

#include <behaviors.dtsi>
#include <behaviors/mouse_key_press.dtsi>
#if defined (MIRYOKU_KLUDGE_MOUSEKEYSPR)
  #include <behaviors/mouse_move.dtsi>
  #include <behaviors/mouse_scroll.dtsi>
#endif
#include <dt-bindings/zmk/keys.h>

#define HOST_OS 2
#include "zmk-helpers/helper.h"
#include "zmk-helpers/unicode-chars/french-altcodes.dtsi"
#include "zmk-helpers/key-labels/42.h"

#undef COMBO_TERM
#define COMBO_TERM 50


// Mac accent

//Â â
ZMK_BEHAVIOR(macircumflex, macro,
    wait-ms = <0>;
    tap-ms = <0>;
    bindings = <&kp LA(I) &kp A>;
)

ZMK_BEHAVIOR(mcacircumflex, macro,
    wait-ms = <0>;
    tap-ms = <0>;
    bindings = <&kp LA(I) &kp LS(A)>;
)

UC_MODMORPH(mmacircumflex, &macircumflex, &mcacircumflex)

ZMK_COMBO(cacircumflex,  &mmacircumflex, LT2 LT3 LT4, 10) 

//À à
ZMK_BEHAVIOR(magrave, macro,
    wait-ms = <0>;
    tap-ms = <0>;
    bindings = <&kp LA(GRAVE) &kp A>;
)

ZMK_BEHAVIOR(mcagrave, macro,
    wait-ms = <0>;
    tap-ms = <0>;
    bindings = <&kp LA(GRAVE) &kp LS(A)>;
)

UC_MODMORPH(mmagrave, &magrave, &mcagrave)

ZMK_COMBO(cagrave,  &mmagrave, LT3 LT4, 10) 

//Ê ê
ZMK_BEHAVIOR(mecircumflex, macro,
    wait-ms = <0>;
    tap-ms = <0>;
    bindings = <&kp LA(I) &kp E>;
)

ZMK_BEHAVIOR(mcecircumflex, macro,
    wait-ms = <0>;
    tap-ms = <0>;
    bindings = <&kp LA(I) &kp LS(E)>;
)

UC_MODMORPH(mmecircumflex, &mecircumflex, &mcecircumflex)

ZMK_COMBO(cecircumflex,  &mmecircumflex, LT1 LT2 LT3, 10) 

//É é
ZMK_BEHAVIOR(mecute, macro,
    wait-ms = <0>;
    tap-ms = <0>;
    bindings = <&kp LA(E) &kp E>;
)

ZMK_BEHAVIOR(mcecute, macro,
    wait-ms = <0>;
    tap-ms = <0>;
    bindings = <&kp LA(E) &kp LS(E)>;
)

UC_MODMORPH(mmecute, &mecute, &mcecute)

ZMK_COMBO(cecute,  &mmecute, LT2 LT3, 10) 


//È è

ZMK_BEHAVIOR(megrave, macro,
    wait-ms = <0>;
    tap-ms = <0>;
    bindings = <&kp LA(GRAVE) &kp E>;
)

ZMK_BEHAVIOR(mcegrave, macro,
    wait-ms = <0>;
    tap-ms = <0>;
    bindings = <&kp LA(GRAVE) &kp LS(E)>;
)

UC_MODMORPH(mmegrave, &megrave, &mcegrave)

ZMK_COMBO(cegrave,  &mmegrave, LT1 LT2, 10) 

//Ï ï

ZMK_BEHAVIOR(mediaresis, macro,
    wait-ms = <0>;
    tap-ms = <0>;
    bindings = <&kp LA(U) &kp E>;
)

ZMK_BEHAVIOR(mcediaresis, macro,
    wait-ms = <0>;
    tap-ms = <0>;
    bindings = <&kp LA(U) &kp LS(E)>;
)

UC_MODMORPH(mmediaresis, &mediaresis, &mcediaresis)

ZMK_COMBO(cediaresis,  &mmediaresis, LT1 LT3, 10) 



//Ç

UC_MODMORPH(mccedilla, &kp LA(C), &kp LA(LS(C)))

ZMK_COMBO(mmccedilla,  &mccedilla, LB1 LB2, 10, 30, 150) 

//Û û
ZMK_BEHAVIOR(mucircumflex, macro,
    wait-ms = <0>;
    tap-ms = <0>;
    bindings = <&kp LA(I) &kp U>;
)

ZMK_BEHAVIOR(mcucircumflex, macro,
    wait-ms = <0>;
    tap-ms = <0>;
    bindings = <&kp LA(I) &kp LS(U)>;
)

UC_MODMORPH(mmucircumflex, &mucircumflex, &mcucircumflex)

ZMK_COMBO(cucircumflex,  &mmucircumflex, RT0 RT1 RT2, 10) 

//Ù ù

ZMK_BEHAVIOR(mugrave, macro,
    wait-ms = <0>;
    tap-ms = <0>;
    bindings = <&kp LA(GRAVE) &kp U>;
)

ZMK_BEHAVIOR(mcugrave, macro,
    wait-ms = <0>;
    tap-ms = <0>;
    bindings = <&kp LA(GRAVE) &kp LS(U)>;
)

UC_MODMORPH(mmugrave, &mugrave, &mcugrave)

ZMK_COMBO(cugrave,  &mmugrave, RT1 RT2, 10, 30, 150) 





//Î î
ZMK_BEHAVIOR(micircumflex, macro,
    wait-ms = <0>;
    tap-ms = <0>;
    bindings = <&kp LA(I) &kp I>;
)

ZMK_BEHAVIOR(mcicircumflex, macro,
    wait-ms = <0>;
    tap-ms = <0>;
    bindings = <&kp LA(I) &kp LS(I)>;
)

UC_MODMORPH(mmicircumflex, &micircumflex, &mcicircumflex)

ZMK_COMBO(cicircumflex,  &mmicircumflex, RT1 RT2 RT3, 10) 

//Ï ï

ZMK_BEHAVIOR(midiaresis, macro,
    wait-ms = <0>;
    tap-ms = <0>;
    bindings = <&kp LA(U) &kp I>;
)

ZMK_BEHAVIOR(mcidiaresis, macro,
    wait-ms = <0>;
    tap-ms = <0>;
    bindings = <&kp LA(U) &kp LS(I)>;
)

UC_MODMORPH(mmidiaresis, &midiaresis, &mcidiaresis)

ZMK_COMBO(cidiaresis,  &mmidiaresis, RT1 RT3, 10) 


//Ô ô
ZMK_BEHAVIOR(mocircumflex, macro,
    wait-ms = <0>;
    tap-ms = <0>;
    bindings = <&kp LA(I) &kp O>;
)

ZMK_BEHAVIOR(mcocircumflex, macro,
    wait-ms = <0>;
    tap-ms = <0>;
    bindings = <&kp LA(I) &kp LS(O)>;
)

UC_MODMORPH(mmocircumflex, &mocircumflex, &mcocircumflex)

ZMK_COMBO(cocircumflex,  &mmocircumflex, RT3 RT4, 10) 

//Win Alt+Tab swapper, requires PR #1366
ZMK_BEHAVIOR(win_swapper, tri_state,
    bindings = <&kt LALT>, <&kp TAB>, <&kt LALT>;
    timeout-ms = <500>;
    ignored-key-positions = <LB0 LM0>;
)

ZMK_COMBO(winsw_app, &win_swapper, LB0 LM0, 0)

//Mac Gui+Tab swapper, requires PR #1366
ZMK_BEHAVIOR(swapper, tri_state,
    bindings = <&kt LGUI>, <&kp TAB>, <&kt LGUI>;
    timeout-ms = <500>;
    ignored-key-positions = <LB0 LM0 LM1 RM1>;
)

ZMK_COMBO(sw_app, &swapper, LB0 LM0,10)



//Mac window
ZMK_COMBO(sw_mwindow, &kp LG(GRAVE), LT0 LM0, 10)

//Mac Space
ZMK_COMBO(spaceleft, &kp LC(LEFT), LB2 LM2, 10)
ZMK_COMBO(spaceright, &kp LC(RIGHT), LB1 LM1, 10)


//Dev Macro Combo
ZMK_BEHAVIOR(arrowfunction, macro,
    wait-ms = <0>;
    tap-ms = <0>;
    bindings = <&kp EQUAL &kp LS(DOT)>;
)
ZMK_COMBO(carrowfunction, &arrowfunction, LM0 LM1, 7 16)

ZMK_BEHAVIOR(closinghtmltag, macro,
    wait-ms = <0>;
    tap-ms = <0>;
    bindings = <&kp SLASH &kp LS(DOT)>;
)
ZMK_COMBO(cclosinghtmltag, &closinghtmltag, RB3 RB4, 0 10)


//Windows accents

ZMK_COMBO(acircumflex,  &fr_a_circumflex, LT2 LT3 LT4, 0) 
ZMK_COMBO(agrave,  &fr_a_grave, LT3 LT4, 0) 

ZMK_COMBO(ecute,  &fr_e_acute, LT2 LT3, 0) 
ZMK_COMBO(egrave,  &fr_e_grave, LT1 LT2, 0) 
ZMK_COMBO(ecirconflex,  &fr_e_circumflex, LT1 LT2 LT3,  0)  
ZMK_COMBO(ediaeresis,  &fr_e_diaeresis, LT1 LT3,  0)  
  
ZMK_COMBO(ccedilla,  &fr_c_cedilla, LB1 LB2, 0) 

ZMK_COMBO(ucirconflex,  &fr_u_circumflex, RT0 RT1 RT2, 0) 
ZMK_COMBO(ugrave,  &fr_u_grave, RT1 RT2, 0) 

ZMK_COMBO(icirconflex,  &fr_i_circumflex, RT1 RT2 RT3, 0) 
ZMK_COMBO(idiaresis,  &fr_i_diaeresis, RT1 RT3, 0) 

ZMK_COMBO(ocircumflex,  &fr_o_circumflex, RT3 RT4, 0) 

ZMK_UNICODE_SINGLE(euro_sign, KP_N0, KP_N1, KP_N2, KP_N8)


#include "custom_behaviors.dtsi"

#include <dt-bindings/zmk/bt.h>
#include <dt-bindings/zmk/rgb.h>
#include <dt-bindings/zmk/outputs.h>
#include <dt-bindings/zmk/ext_power.h>
#include "miryoku.h"

#include <dt-bindings/zmk/mouse.h>

/ {
  keymap {
    compatible = "zmk,keymap";
#define MIRYOKU_X(LAYER, STRING) \
    LAYER { \
      label = STRING; \
      bindings = < U_MACRO_VA_ARGS(MIRYOKU_LAYERMAPPING_##LAYER, MIRYOKU_LAYER_##LAYER) >; \
    };
MIRYOKU_LAYER_LIST
#undef MIRYOKU_X
  };
};

#include "miryoku_shift_functions.dtsi"

#include "miryoku_double_tap_guard.dtsi"

#if defined (MIRYOKU_KLUDGE_MOUSEKEYSPR)
  #include "miryoku_kludge_mousekeyspr.dtsi"
#else
  #include "miryoku_mousekeys.dtsi"
#endif

#if defined (MIRYOKU_KLUDGE_THUMBCOMBOS)
  #include "miryoku_kludge_thumbcombos.dtsi"
#endif

#if defined (MIRYOKU_KLUDGE_TOPROWCOMBOS)
  #include "miryoku_kludge_toprowcombos.dtsi"
#endif

#if defined (MIRYOKU_KLUDGE_BOTTOMROWCOMBOS)
  #include "miryoku_kludge_bottomrowcombos.dtsi"
#endif

#if defined (MIRYOKU_KLUDGE_TAPDELAY)
  #include "miryoku_kludge_tapdelay.dtsi"
#else
  #include "miryoku_behaviors.dtsi"
#endif

#include "custom_macro.dtsi"
#include "custom_combo.dtsi"